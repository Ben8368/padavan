## trunk/linux-4.4.x/arch/mips/ralink/Kconfig
```kconfig
if RALINK

config CEVT_SYSTICK_QUIRK
	bool
	default n

config CLKEVT_RT3352
	bool
	depends on SOC_MT7620
	default y
	select CLKSRC_OF
	select CLKSRC_MMIO
	select CEVT_SYSTICK_QUIRK

config IRQ_INTC
	bool
	default y

config RALINK_MT7620
	bool
	default n

choice
	prompt "Ralink SoC selection"
	default SOC_MT7620
	help
	  Select Ralink MIPS SoC type.

	config SOC_MT7620
		bool "MT7620/8"
		select HW_HAS_PCI
		select RALINK_MT7620
endchoice

config RALINK_BUILTIN_DTB_NAME
	string "Built in DTB"
	help
	  Set the name of the DTB to embed in the vmlinux binary

endif
```
